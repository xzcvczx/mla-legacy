<h1>Google PowerMeter Demo</h1>
<h2>Overview</h2>
Google PowerMeter allows your customers to access their power consumption data through a secure, web-based iGoogle gadget.
The data can be published immediately (low latency for the consumer) but is currently limited to uploads at 10 minute intervals.
<h3><b>Before a Customer Can View Data...</b></h3>

<ol style="list-style-type:decimal">
<li>The customer creates a personal <a href="https://www.google.com/accounts/NewAccount?service=mail&continue=http%3A%2F%2Fmail.google.com%2Fmail%2Fe-11-1122b0e1805db420c36c7c5d4ab51158-27717102c1757ecb2fdcad261b1d46b4f6c540c4&type=2">Google account</a>. </li>
<li>Devices monitoring energy consumption get activated and subsequently authorized to upload data to Google PowerMeter.<br /></li>
<li>The customer completes the short enrollment process, which automatically sets up their Google PowerMeter account and adds the
Google PowerMeter gadget to their iGoogle page.</li>
<li>Activated devices then stream data to Google servers via the
<a href="http://code.google.com/apis/powermeter/">Google Meter API</a>.</li>
<li>The gadget displays the customer's usage data.</li>
</ol>

<h2>Google PowerMeter Device Partners</h2>

<div>Google Provides an <a href="http://code.google.com/apis/powermeter/">informational web site</a> for
Google PowerMeter device developers. This site contains documentation and supporting materials (client libraries, FAQs,
etc.) on the Google PowerMeter API.</div>

<h2>More Information</h2>

<ul>
<li>Microchip Google PowerMeter Demo Help -- This help file was installed with the Google PowerMeter demo.  It provides
information about running the demos and about how to customize the code for your own application.</li>
<li><a href="http://www.google.org/powermeter/">Google PowerMeter Description</a> 
-- A brief, non-technical description of how Google PowerMeter can help conserve energy.</li>
<li><a href="http://www.google.org/powermeter/faqs.html">Why Did Google Create PowerMeter?</a> 
-- Answers to this and other questions that your customers will probably ask.</li>
<li><a href="mailto:powermeter-partner@google.com">powermeter-partner@google.com</a>
-- Google PowerMeter Business Development.  Assists with Google PowerMeter contract, product, and legal issues.</li>
<li><a href="mailto:google-powermeter-partner-support@google.com">google-powermeter-partner-support@google.com</a>
-- Google PowerMeter technical support group.  Assists with technical issues.</li>
<li><a href="http://support.microchip.com">Microchip Technology Technical Support</a> 
-- Microchip's support site.  Provides answers for questions about the MPLAB IDE, tools, projects, the TCP/IP Stack,
or the demo hardware and firmware that aren't answered in the help file.</li>
</ul>
